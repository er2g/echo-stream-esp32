## sdkconfig.defaults
```kconfig
CONFIG_IDF_TARGET="esp32s3"
CONFIG_APP_BUILD_TYPE_APP_2NDBOOT=y
CONFIG_TINYUSB_ENABLED=y
CONFIG_TINYUSB_DEVICE_ENABLED=y
CONFIG_UAC_MIC_INTERVAL_MS=10
CONFIG_UAC_MIC_CHANNEL_NUM=1
CONFIG_UAC_SPK_CHANNEL_NUM=0
CONFIG_UAC_SAMPLE_RATE=48000
```
